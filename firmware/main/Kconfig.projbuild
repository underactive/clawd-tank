## firmware/main/Kconfig.projbuild
```kconfig
# firmware/main/Kconfig.projbuild
menu "Clawd Configuration"

    choice CLAWD_BOARD
        prompt "Target board"
        default BOARD_WAVESHARE_C6_LCD147
        help
            Selects the physical hardware target.

            The Waveshare board is the original (and only pre-v1.4) target:
            ESP32-C6 + 320x172 ST7789 SPI display, no PSRAM, 8 MB flash.

            The Freenove board (fnk0104) is the second supported target:
            ESP32-S3 + 320x240 ILI9341 SPI display, FT6336G capacitive touch,
            8 MB OPI PSRAM, 16 MB flash, battery sense on GPIO 9.

        config BOARD_WAVESHARE_C6_LCD147
            bool "Waveshare ESP32-C6-LCD-1.47"
            depends on IDF_TARGET_ESP32C6

        config BOARD_FREENOVE_S3_28
            bool "Freenove ESP32-S3 2.8\" (fnk0104)"
            depends on IDF_TARGET_ESP32S3

    endchoice

    config CLAWD_WIFI_ENABLED
        bool "Enable WiFi (debug/setup)"
        default n
        help
            Enable WiFi for OTA updates and debug logging.
            Not needed for normal BLE notification operation.

endmenu
```

## firmware/sdkconfig.defaults
```kconfig
# firmware/sdkconfig.defaults
#
# Board-agnostic settings. Per-target overlays live in:
#   - sdkconfig.defaults.esp32c6  (Waveshare ESP32-C6-LCD-1.47)
#   - sdkconfig.defaults.esp32s3  (Freenove ESP32-S3 2.8", fnk0104)
#
# ESP-IDF applies sdkconfig.defaults first, then sdkconfig.defaults.<target>
# on top. Settings below apply to every supported board.

# BLE (NimBLE)
CONFIG_BT_ENABLED=y
CONFIG_BT_NIMBLE_ENABLED=y
CONFIG_BT_NIMBLE_ROLE_PERIPHERAL=y
CONFIG_BT_NIMBLE_ROLE_CENTRAL=n
CONFIG_BT_NIMBLE_ROLE_OBSERVER=n
CONFIG_BT_NIMBLE_ROLE_BROADCASTER=n
CONFIG_BT_NIMBLE_ATT_PREFERRED_MTU=256

# SPI LCD
CONFIG_LCD_HOST_SPI2=y

# Partition table
CONFIG_PARTITION_TABLE_CUSTOM=y
CONFIG_PARTITION_TABLE_CUSTOM_FILENAME="partitions.csv"

# LVGL
CONFIG_LV_COLOR_DEPTH_16=y
CONFIG_LV_FONT_MONTSERRAT_8=y
CONFIG_LV_FONT_MONTSERRAT_10=y
CONFIG_LV_FONT_MONTSERRAT_12=y
CONFIG_LV_FONT_MONTSERRAT_14=y
CONFIG_LV_FONT_MONTSERRAT_18=y

# FreeRTOS
CONFIG_FREERTOS_HZ=1000

# Board selector (default; overridden per-target to point at the right board)
CONFIG_BOARD_WAVESHARE_C6_LCD147=y
```

## firmware/sdkconfig.defaults.esp32c6
```kconfig
# firmware/sdkconfig.defaults.esp32c6
#
# Waveshare ESP32-C6-LCD-1.47 (ESP32-C6FH8, 8 MB embedded flash, no PSRAM).

# Flash (ESP32-C6FH8 has 8 MB embedded flash)
CONFIG_ESPTOOLPY_FLASHSIZE_8MB=y
CONFIG_ESPTOOLPY_FLASHSIZE="8MB"

# Board selector
CONFIG_BOARD_WAVESHARE_C6_LCD147=y
CONFIG_BOARD_FREENOVE_S3_28=n
```

## firmware/sdkconfig.defaults.esp32s3
```kconfig
# firmware/sdkconfig.defaults.esp32s3
#
# Freenove ESP32-S3 2.8" (fnk0104):
#   - ESP32-S3 dual-core
#   - 16 MB QIO-OPI flash
#   - 8 MB OPI PSRAM (80 MHz)
#   - ILI9341 320×240 SPI display
#   - FT6336G capacitive touch
#   - WS2812B NeoPixel on GPIO 42
#   - Battery sense on GPIO 9 (2× divider)

# Board selector
CONFIG_BOARD_FREENOVE_S3_28=y
CONFIG_BOARD_WAVESHARE_C6_LCD147=n

# Flash: 16 MB, Octal mode (QIO-OPI per the Freenove spec)
CONFIG_ESPTOOLPY_FLASHSIZE_16MB=y
CONFIG_ESPTOOLPY_FLASHSIZE="16MB"
CONFIG_ESPTOOLPY_FLASHMODE_OPI=y

# PSRAM: 8 MB Octal, 80 MHz
CONFIG_SPIRAM=y
CONFIG_SPIRAM_MODE_OCT=y
CONFIG_SPIRAM_TYPE_AUTO=y
CONFIG_SPIRAM_SPEED_80M=y
# Let both malloc() and heap_caps_malloc(..., MALLOC_CAP_SPIRAM) see PSRAM.
# We gate MALLOC_CAP_SPIRAM explicitly at allocation sites for sprite buffers,
# but leaving generic malloc with PSRAM-capable fallback removes a failure mode
# when large allocations land during BLE connection setup.
CONFIG_SPIRAM_USE_MALLOC=y
# Internal allocator treats PSRAM as second-tier; prefer internal SRAM for small
# allocs so BLE/FreeRTOS critical structures stay fast and DMA-capable.
CONFIG_SPIRAM_TRY_ALLOCATE_WIFI_LWIP=y

# Dual-core
# (ESP-IDF default for esp32s3 is dual-core already; being explicit guards
# against accidental unicore carryover.)
CONFIG_FREERTOS_UNICORE=n

# USB-CDC serial console on fnk0104's native USB port
CONFIG_ESP_CONSOLE_USB_SERIAL_JTAG=y
```
